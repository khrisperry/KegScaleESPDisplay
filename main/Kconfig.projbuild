## main/Kconfig.projbuild
```kconfig
menu "Keg Scale Display"

config KEG_DISPLAY_SLEEP_SECONDS
    int "Timer wake interval (seconds)"
    range 30 3600
    default 180
    help
        Normal deep-sleep timer wake interval. The scale-owned display setting can
        disable this frequent periodic wake. Before every deep sleep all stale
        wake sources are cleared, then touch plus either this timer or the hourly
        safety timer are armed.

config KEG_DISPLAY_SAFETY_WAKE_SECONDS
    int "Safety wake interval when periodic check-in is disabled (seconds)"
    range 900 86400
    default 3600
    help
        Fallback timer used when the scale-owned three-minute check-in setting is
        disabled. It guarantees that the display checks in even if capacitive
        touch is unavailable or stops working.

config KEG_DISPLAY_SCAN_SECONDS
    int "Initial pairing scan duration (seconds)"
    range 2 30
    default 6

config KEG_DISPLAY_AUTO_PAIR_SINGLE
    bool "Automatically pair when exactly one compatible scale is visible"
    default y
    help
        If more than one compatible scale is visible, firmware never guesses.

config KEG_DISPLAY_TOUCH_WAKE
    bool "Use native capacitive touch on GPIO12 as a deep-sleep wake source"
    default y
    help
        GPIO12 is touch channel 5 on the classic ESP32 used by the T5 V2.3.1.
        Touch wake replaces the temporary GPIO39 EXT0 button wake because ESP32
        does not allow touch wake and EXT0 wake at the same time.

config KEG_DISPLAY_TOUCH_THRESHOLD_PERCENT
    int "Touch sensitivity threshold below baseline (percent)"
    depends on KEG_DISPLAY_TOUCH_WAKE
    range 1 50
    default 3
    help
        ESP32 touch values decrease when touched. The wake threshold is calibrated
        before each deep sleep as this percentage below the untouched benchmark.
        Lower values are more sensitive; higher values require a stronger touch.

config KEG_DISPLAY_TOUCH_INITIAL_WAIT_SECONDS
    int "Touch wake initial pour wait (seconds)"
    depends on KEG_DISPLAY_TOUCH_WAKE
    range 1 30
    default 10
    help
        After touch acknowledgment, deep-sleep with only the timer armed before
        one BLE fetch. Touch cannot retrigger this short pour delay.

config KEG_DISPLAY_TOUCH_RETRY_SECONDS
    int "Touch wake retry interval (seconds)"
    depends on KEG_DISPLAY_TOUCH_WAKE
    range 1 10
    default 5
    help
        After an unstable first touch result, deep-sleep this long then fetch
        once more. A stable unchanged result never retries. Timer checks do not
        use this settling retry.

endmenu
```

## tc001/main/Kconfig.projbuild
```kconfig
menu "Keg TC001"
config TC001_DEMO
    bool "Show sample data without a scale (clearly labeled DEMO)"
    default n
config TC001_MATRIX_LAYOUT
    int "Matrix wiring: 0=row serpentine, 1=8x8 tiles, 2=column serpentine"
    range 0 2
    default 0
endmenu
```

## touchpour/components/tap_control/Kconfig.projbuild
```kconfig
menu "TouchPour hardware"
config TAP_SDA
    int "LiDAR SDA GPIO"
    default 11
config TAP_SCL
    int "LiDAR SCL GPIO"
    default 10
config TAP_SERVO
    int "Servo signal GPIO"
    default 15
config TAP_BUTTON
    int "Optional physical pour button GPIO"
    default 18
endmenu
```
